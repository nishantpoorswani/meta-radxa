## conf/bblayers.conf.sample
```bitbake
# POKY_BBLAYERS_CONF_VERSION is increased each time build/conf/bblayers.conf
# changes incompatibly
POKY_BBLAYERS_CONF_VERSION = "2"

BBPATH = "${TOPDIR}"
BBFILES ?= ""

BBLAYERS ?= " \
  ${TOPDIR}/../meta \
  ${TOPDIR}/../meta-poky \
  ${TOPDIR}/../meta-yocto-bsp \
  ${TOPDIR}/../meta-openembedded/meta-oe \
  ${TOPDIR}/../meta-openembedded/meta-networking \
  ${TOPDIR}/../meta-openembedded/meta-python \
  ${TOPDIR}/../meta-radxa \
  "
```

## conf/layer.conf
```bitbake
# We have a conf and classes directory, append to BBPATH
BBPATH .= ":${LAYERDIR}"

# We have a recipes directory, add to BBFILES
BBFILES += "${LAYERDIR}/recipes*/*/*.bb ${LAYERDIR}/recipes*/*/*.bbappend"

BBFILE_COLLECTIONS += "meta-radxa"
BBFILE_PATTERN_meta-radxa := "^${LAYERDIR}/"
BBFILE_PRIORITY_meta-radxa = "1"

LAYERSERIES_COMPAT_meta-radxa = "dunfell"
```

## conf/local.conf.sample
```bitbake
#
# This file is your local configuration file and is where all local user settings
# are placed. The comments in this file give some guide to the options a new user
# to the system might want to change but pretty much any configuration option can
# be set in this file. More adventurous users can look at local.conf.extended
# which contains other examples of configuration which can be placed in this file
# but new users likely won't need any of them initially.
#
# Lines starting with the '#' character are commented out and in some cases the
# default values are provided as comments to show people example syntax. Enabling
# the option is a question of removing the # character and making any change to the
# variable as required.

#
# Machine Selection
#
# You need to select a specific machine to target the build with.
#MACHINE ?= "rockpi-s-rk3308"
#MACHINE ?= "rockpi-4b-rk3399"
#MACHINE ?= "rockpi-e-rk3328"

DISTRO ?= "poky"
#
# Package Management configuration
#
# This variable lists which packaging formats to enable. Multiple package backends
# can be enabled at once and the first item listed in the variable will be used
# to generate the root filesystems.
# Options are:
#  - 'package_deb' for debian style deb files
#  - 'package_ipk' for ipk files are used by opkg (a debian style embedded package manager)
#  - 'package_rpm' for rpm style packages
# E.g.: PACKAGE_CLASSES ?= "package_rpm package_deb package_ipk"
# We default to rpm:
PACKAGE_CLASSES ?= "package_rpm"

#
# Additional image features
#
# The following is a list of additional classes to use when building images which
# enable extra features. Some available options which can be included in this variable
# are:
#   - 'buildstats' collect build statistics
#   - 'image-mklibs' to reduce shared library files size for an image
#   - 'image-prelink' in order to prelink the filesystem image
# NOTE: if listing mklibs & prelink both, then make sure mklibs is before prelink
# NOTE: mklibs also needs to be explicitly enabled for a given image, see local.conf.extended
USER_CLASSES ?= "buildstats image-mklibs image-prelink"

#
# Interactive shell configuration
#
# Under certain circumstances the system may need input from you and to do this it
# can launch an interactive shell. It needs to do this since the build is
# multithreaded and needs to be able to handle the case where more than one parallel
# process may require the user's attention. The default is iterate over the available
# terminal types to find one that works.
#
# Examples of the occasions this may happen are when resolving patches which cannot
# be applied, to use the devshell or the kernel menuconfig
#
# Supported values are auto, gnome, xfce, rxvt, screen, konsole (KDE 3.x only), none
# Note: currently, Konsole support only works for KDE 3.x due to the way
# newer Konsole versions behave
#OE_TERMINAL = "auto"
# By default disable interactive patch resolution (tasks will just fail instead):
PATCHRESOLVE = "noop"

#
# Disk Space Monitoring during the build
#
# Monitor the disk space during the build. If there is less that 1GB of space or less
# than 100K inodes in any key build location (TMPDIR, DL_DIR, SSTATE_DIR), gracefully
# shutdown the build. If there is less that 100MB or 1K inodes, perform a hard abort
# of the build. The reason for this is that running completely out of space can corrupt
# files and damages the build in ways which may not be easily recoverable.
# It's necesary to monitor /tmp, if there is no space left the build will fail
# with very exotic errors.
BB_DISKMON_DIRS ??= "\
    STOPTASKS,${TMPDIR},1G,100K \
    STOPTASKS,${DL_DIR},1G,100K \
    STOPTASKS,${SSTATE_DIR},1G,100K \
    STOPTASKS,/tmp,100M,100K \
    ABORT,${TMPDIR},100M,1K \
    ABORT,${DL_DIR},100M,1K \
    ABORT,${SSTATE_DIR},100M,1K \
    ABORT,/tmp,10M,1K"

# CONF_VERSION is increased each time build/conf/ changes incompatibly and is used to
# track the version of this file when it was generated. This can safely be ignored if
# this doesn't mean anything to you.
CONF_VERSION = "1"

DISTRO_FEATURES_append = " pam systemd"
VIRTUAL-RUNTIME_init_manager = "systemd"
PACKAGECONFIG_append_pn-systemd = " resolved networkd"
```

## conf/machine/include/rockpi-4.inc
```bitbake
SOC_FAMILY = "rk3399"

require conf/machine/include/arm/arch-armv8a.inc
require conf/machine/include/soc-family.inc

MACHINEOVERRIDES =. "mali-gpu:mali-midgard:"

PREFERRED_PROVIDER_virtual/kernel = "linux-rockpi-4"
PREFERRED_VERSION_linux-rockchip = "4.4"

SERIAL_CONSOLES = "1500000;ttyFIQ0"
KERNEL_IMAGETYPE = "Image"
KBUILD_DEFCONFIG = "rockchip_linux_defconfig"

PREFERRED_PROVIDER_virtual/bootloader ?= "u-boot-rockpi-4"

MACHINE_ESSENTIAL_EXTRA_RRECOMMENDS += "\
   kernel-modules \
"

IMAGE_FSTYPES += "rockchip-radxa-gpt-img"
IMAGE_CLASSES += "rockchip-radxa-gpt-img"
```

## conf/machine/rockpi-4-rk3399.conf
```bitbake
#@TYPE: Machine
#@NAME: RockPi-4 machine
#@DESCRIPTION: RockPi-4 development board config file

SOC_FAMILY = "rk3399"

require conf/machine/include/tune-cortexa72.inc
require conf/machine/include/soc-family.inc

MACHINEOVERRIDES =. "mali-gpu:mali-midgard:"

PREFERRED_PROVIDER_virtual/kernel = "linux-rockpi-4"
PREFERRED_VERSION_linux-rockchip = "4.4"

SERIAL_CONSOLES = "1500000;ttyFIQ0"
KERNEL_IMAGETYPE = "Image"
KBUILD_DEFCONFIG = "rockchip_linux_defconfig"

PREFERRED_PROVIDER_virtual/bootloader ?= "u-boot-rockpi-4"

KERNEL_DEVICETREE = "rockchip/rockpi-4b-linux.dtb"
UBOOT_MACHINE = "rock-pi-4-rk3399_defconfig"

MACHINE_ESSENTIAL_EXTRA_RRECOMMENDS += "\
   kernel-modules \
"
IMAGE_FSTYPES += "rockchip-radxa-gpt-img"
IMAGE_CLASSES += "rockchip-radxa-gpt-img"
```

## conf/machine/rockpi-4a-rk3399.conf
```bitbake
#@TYPE: Machine
#@NAME: RockPi-4a machine
#@DESCRIPTION: RockPi-4a development board config file

require conf/machine/include/rockpi-4.inc

KERNEL_DEVICETREE = "rockchip/rk3399-rock-pi-4a.dtb"
UBOOT_MACHINE = "rock-pi-4a-rk3399_defconfig"
```

## conf/machine/rockpi-4b-rk3399.conf
```bitbake
#@TYPE: Machine
#@NAME: RockPi-4b machine
#@DESCRIPTION: RockPi-4b development board config file

require conf/machine/include/rockpi-4.inc

KERNEL_DEVICETREE = "rockchip/rockpi-4b-linux.dtb"
UBOOT_MACHINE = "rock-pi-4b-rk3399_defconfig"

MACHINE_ESSENTIAL_EXTRA_RRECOMMENDS += "\
   brcm-tools \
   rkwifibt-firmware-ap6256-wifi \
   rkwifibt-firmware-ap6256-bt \
   bluetooth-broadcom \
"
```

## conf/machine/rockpi-4c-rk3399.conf
```bitbake
#@TYPE: Machine
#@NAME: RockPi-4c machine
#@DESCRIPTION: RockPi-4c development board config file

require conf/machine/include/rockpi-4.inc

KERNEL_DEVICETREE = "rockchip/rk3399-rock-pi-4c.dtb"
UBOOT_MACHINE = "rock-pi-4c-rk3399_defconfig"

MACHINE_ESSENTIAL_EXTRA_RRECOMMENDS += "\
   brcm-tools \
   rkwifibt-firmware-ap6256-wifi \
   rkwifibt-firmware-ap6256-bt \
   bluetooth-broadcom \
"
```

## conf/machine/rockpi-e-rk3328.conf
```bitbake
#@TYPE: Machine
#@NAME: RockPi-e machine
#@DESCRIPTION: RockPi-e development board config file

SOC_FAMILY = "rk3328"

DEFAULTTUNE ?= "cortexa53-crypto"
require conf/machine/include/tune-cortexa53.inc
require conf/machine/include/soc-family.inc

MACHINEOVERRIDES =. "mali-gpu:mali-midgard:"

PREFERRED_PROVIDER_virtual/kernel = "linux-rockpi-e"
PREFERRED_VERSION_linux-rockchip = "4.4"

SERIAL_CONSOLES = "1500000;ttyFIQ0"
KERNEL_IMAGETYPE = "Image"
KBUILD_DEFCONFIG = "rockchip_linux_defconfig"

PREFERRED_PROVIDER_virtual/bootloader ?= "u-boot-rockpi-e"

KERNEL_DEVICETREE = "rockchip/rk3328-rock-pi-e.dtb"
UBOOT_MACHINE = "rock-pi-e-rk3328_defconfig"

MACHINE_ESSENTIAL_EXTRA_RRECOMMENDS += "\
   kernel-modules \
   rtl-tools \
   rkwifibt-firmware-rtl8723du-bt \
   rkwifibt-firmware-rtl8821cu-bt \
"
IMAGE_FSTYPES += "rockchip-radxa-gpt-img"
IMAGE_CLASSES += "rockchip-radxa-gpt-img"
```

## conf/machine/rockpi-n10-rk3399pro.conf
```bitbake
#@TYPE: Machine
#@NAME: RockPi-n10 machine
#@DESCRIPTION: RockPi-n10 development board config file

SOC_FAMILY = "rk3399pro"

require conf/machine/include/arm/arch-armv8a.inc
require conf/machine/include/soc-family.inc

MACHINEOVERRIDES =. "mali-gpu:mali-midgard:"

PREFERRED_PROVIDER_virtual/kernel = "linux-rockpi-n10"
PREFERRED_VERSION_linux-rockchip = "4.4"

SERIAL_CONSOLES = "1500000;ttyS2"
KERNEL_IMAGETYPE = "Image"
KBUILD_DEFCONFIG = "rockchip_linux_defconfig"

PREFERRED_PROVIDER_virtual/bootloader ?= "u-boot-rockpi-n10"

KERNEL_DEVICETREE = "rockchip/rk3399pro-rockpi-n10-linux.dtb"
UBOOT_MACHINE = "rk3399pro-rockpi-n10-linux_defconfig"

MACHINE_ESSENTIAL_EXTRA_RRECOMMENDS += "\
   kernel-modules \
   brcm-tools \
   rkwifibt-firmware-ap6236-wifi \
   rkwifibt-firmware-ap6236-bt \
   rkwifibt-firmware-ap6256-wifi \
   rkwifibt-firmware-ap6256-bt \
   rkwifibt-firmware-ap6398s-wifi \
   rkwifibt-firmware-ap6398s-bt \
   bluetooth-broadcom \
"

IMAGE_FSTYPES += "rockchip-radxa-gpt-img"
IMAGE_CLASSES += "rockchip-radxa-gpt-img"
```

## conf/machine/rockpi-px30.conf
```bitbake
#@TYPE: Machine
#@NAME: RockPi-PX30 machine
#@DESCRIPTION: RockPi-PX30 development board config file

SOC_FAMILY = "px30"

DEFAULTTUNE ?= "cortexa35-crypto"
require conf/machine/include/tune-cortexa35.inc
require conf/machine/include/soc-family.inc

MACHINEOVERRIDES =. "mali-gpu:mali-midgard:"

PREFERRED_PROVIDER_virtual/kernel = "linux-rockpi-px30"
PREFERRED_VERSION_linux-rockchip = "4.4"

SERIAL_CONSOLES = "1500000;ttyS1"
KERNEL_IMAGETYPE = "Image"
KBUILD_DEFCONFIG = "px30_linux_defconfig"

PREFERRED_PROVIDER_virtual/bootloader ?= "u-boot-rockpi-px30"

KERNEL_DEVICETREE = "rockchip/px30-rock-pi.dtb"
UBOOT_MACHINE = "rock-pi-px30_defconfig"

MACHINE_ESSENTIAL_EXTRA_RRECOMMENDS += "\
   kernel-modules \
   rtl-tools \
   rkwifibt-firmware-rtl8723du-bt \
"

IMAGE_FSTYPES += "rockchip-radxa-gpt-img"
IMAGE_CLASSES += "rockchip-radxa-gpt-img"
```

## conf/machine/rockpi-s-rk3308.conf
```bitbake
#@TYPE: Machine
#@NAME: RockPi-S machine
#@DESCRIPTION: RockPi-S development board config file

SOC_FAMILY = "rk3308"

DEFAULTTUNE ?= "cortexa35-crypto"
require conf/machine/include/tune-cortexa35.inc
require conf/machine/include/soc-family.inc

MACHINEOVERRIDES =. "mali-gpu:mali-midgard:"

PREFERRED_PROVIDER_virtual/kernel = "linux-rockpi-s"
PREFERRED_VERSION_linux-rockchip = "4.4"

SERIAL_CONSOLES = "1500000;ttyS0"
KERNEL_IMAGETYPE = "Image"
KBUILD_DEFCONFIG = "rk3308_linux_defconfig"

PREFERRED_PROVIDER_virtual/bootloader ?= "u-boot-rockpi-s"

KERNEL_DEVICETREE = "rockchip/rk3308-rock-pi-s.dtb"
UBOOT_MACHINE = "rock-pi-s-rk3308_defconfig"

MACHINE_ESSENTIAL_EXTRA_RRECOMMENDS += "\
   kernel-modules \
   rtl-tools \
   rkwifibt-firmware-rtl8723ds-bt \
"
IMAGE_FSTYPES += "rockchip-radxa-gpt-img"
IMAGE_CLASSES += "rockchip-radxa-gpt-img"
```
